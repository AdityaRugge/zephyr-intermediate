## build-keys/Kconfig/soc/Kconfig
```kconfig
# Load Zephyr SoC Kconfig descriptions.
osource "/opt/zephyr-ws/zephyr/soc/xlnx/zynqmp/Kconfig"
osource "/opt/zephyr-ws/zephyr/soc/xlnx/zynq7000/Kconfig"
osource "/opt/zephyr-ws/zephyr/soc/xen/Kconfig"
osource "/opt/zephyr-ws/zephyr/soc/ti/simplelink/Kconfig"
osource "/opt/zephyr-ws/zephyr/soc/ti/lm3s6965/Kconfig"
osource "/opt/zephyr-ws/zephyr/soc/ti/k3/Kconfig"
osource "/opt/zephyr-ws/zephyr/soc/telink/tlsr/Kconfig"
osource "/opt/zephyr-ws/zephyr/soc/starfive/jh71xx/Kconfig"
osource "/opt/zephyr-ws/zephyr/soc/st/stm32/Kconfig"
osource "/opt/zephyr-ws/zephyr/soc/snps/qemu_arc/Kconfig"
osource "/opt/zephyr-ws/zephyr/soc/snps/nsim/arc_v/Kconfig"
osource "/opt/zephyr-ws/zephyr/soc/snps/nsim/arc_classic/Kconfig"
osource "/opt/zephyr-ws/zephyr/soc/snps/hsdk4xd/Kconfig"
osource "/opt/zephyr-ws/zephyr/soc/snps/hsdk/Kconfig"
osource "/opt/zephyr-ws/zephyr/soc/snps/emsk/Kconfig"
osource "/opt/zephyr-ws/zephyr/soc/snps/emsdp/Kconfig"
osource "/opt/zephyr-ws/zephyr/soc/snps/arc_iot/Kconfig"
osource "/opt/zephyr-ws/zephyr/soc/silabs/Kconfig"
osource "/opt/zephyr-ws/zephyr/soc/sifive/sifive_freedom/Kconfig"
osource "/opt/zephyr-ws/zephyr/soc/rockchip/Kconfig"
osource "/opt/zephyr-ws/zephyr/soc/renode/riscv_virtual/Kconfig"
osource "/opt/zephyr-ws/zephyr/soc/renesas/smartbond/Kconfig"
osource "/opt/zephyr-ws/zephyr/soc/renesas/rzt2m/Kconfig"
osource "/opt/zephyr-ws/zephyr/soc/renesas/rcar/Kconfig"
osource "/opt/zephyr-ws/zephyr/soc/renesas/ra/Kconfig"
osource "/opt/zephyr-ws/zephyr/soc/raspberrypi/Kconfig"
osource "/opt/zephyr-ws/zephyr/soc/quicklogic/eos_s3/Kconfig"
osource "/opt/zephyr-ws/zephyr/soc/qemu/virt_riscv/Kconfig"
osource "/opt/zephyr-ws/zephyr/soc/qemu/malta/Kconfig"
osource "/opt/zephyr-ws/zephyr/soc/openisa/rv32m1/Kconfig"
osource "/opt/zephyr-ws/zephyr/soc/nxp/s32/Kconfig"
osource "/opt/zephyr-ws/zephyr/soc/nxp/rw/Kconfig"
osource "/opt/zephyr-ws/zephyr/soc/nxp/mcx/Kconfig"
osource "/opt/zephyr-ws/zephyr/soc/nxp/lpc/Kconfig"
osource "/opt/zephyr-ws/zephyr/soc/nxp/layerscape/Kconfig"
osource "/opt/zephyr-ws/zephyr/soc/nxp/kinetis/Kconfig"
osource "/opt/zephyr-ws/zephyr/soc/nxp/imxrt/Kconfig"
osource "/opt/zephyr-ws/zephyr/soc/nxp/imx/Kconfig"
osource "/opt/zephyr-ws/zephyr/soc/nuvoton/numicro/Kconfig"
osource "/opt/zephyr-ws/zephyr/soc/nuvoton/numaker/Kconfig"
osource "/opt/zephyr-ws/zephyr/soc/nuvoton/npcx/Kconfig"
osource "/opt/zephyr-ws/zephyr/soc/nordic/Kconfig"
osource "/opt/zephyr-ws/zephyr/soc/neorv32/Kconfig"
osource "/opt/zephyr-ws/zephyr/soc/native/inf_clock/Kconfig"
osource "/opt/zephyr-ws/zephyr/soc/microchip/miv/Kconfig"
osource "/opt/zephyr-ws/zephyr/soc/microchip/mec/Kconfig"
osource "/opt/zephyr-ws/zephyr/soc/mediatek/mtk_adsp/Kconfig"
osource "/opt/zephyr-ws/zephyr/soc/lowrisc/opentitan/Kconfig"
osource "/opt/zephyr-ws/zephyr/soc/litex/litex_vexriscv/Kconfig"
osource "/opt/zephyr-ws/zephyr/soc/ite/ec/Kconfig"
osource "/opt/zephyr-ws/zephyr/soc/intel/raptor_lake/Kconfig"
osource "/opt/zephyr-ws/zephyr/soc/intel/lakemont/Kconfig"
osource "/opt/zephyr-ws/zephyr/soc/intel/intel_socfpga_std/Kconfig"
osource "/opt/zephyr-ws/zephyr/soc/intel/intel_socfpga/Kconfig"
osource "/opt/zephyr-ws/zephyr/soc/intel/intel_niosv/Kconfig"
osource "/opt/zephyr-ws/zephyr/soc/intel/intel_ish/Kconfig"
osource "/opt/zephyr-ws/zephyr/soc/intel/intel_adsp/Kconfig"
osource "/opt/zephyr-ws/zephyr/soc/intel/elkhart_lake/Kconfig"
osource "/opt/zephyr-ws/zephyr/soc/intel/atom/Kconfig"
osource "/opt/zephyr-ws/zephyr/soc/intel/apollo_lake/Kconfig"
osource "/opt/zephyr-ws/zephyr/soc/intel/alder_lake/Kconfig"
osource "/opt/zephyr-ws/zephyr/soc/infineon/cat3/Kconfig"
osource "/opt/zephyr-ws/zephyr/soc/infineon/cat1b/Kconfig"
osource "/opt/zephyr-ws/zephyr/soc/infineon/cat1a/Kconfig"
osource "/opt/zephyr-ws/zephyr/soc/gd/gd32/Kconfig"
osource "/opt/zephyr-ws/zephyr/soc/gaisler/leon3/Kconfig"
osource "/opt/zephyr-ws/zephyr/soc/gaisler/gr716a/Kconfig"
osource "/opt/zephyr-ws/zephyr/soc/espressif/Kconfig"
osource "/opt/zephyr-ws/zephyr/soc/ene/kb1200/Kconfig"
osource "/opt/zephyr-ws/zephyr/soc/efinix/sapphire/Kconfig"
osource "/opt/zephyr-ws/zephyr/soc/cdns/xtensa_sample_controller/Kconfig"
osource "/opt/zephyr-ws/zephyr/soc/cdns/dc233c/Kconfig"
osource "/opt/zephyr-ws/zephyr/soc/brcm/bcmvk/Kconfig"
osource "/opt/zephyr-ws/zephyr/soc/brcm/bcm2712/Kconfig"
osource "/opt/zephyr-ws/zephyr/soc/brcm/bcm2711/Kconfig"
osource "/opt/zephyr-ws/zephyr/soc/atmel/sam0/Kconfig"
osource "/opt/zephyr-ws/zephyr/soc/atmel/sam/Kconfig"
osource "/opt/zephyr-ws/zephyr/soc/aspeed/Kconfig"
osource "/opt/zephyr-ws/zephyr/soc/arm/Kconfig"
osource "/opt/zephyr-ws/zephyr/soc/arm/beetle/Kconfig"
osource "/opt/zephyr-ws/zephyr/soc/andestech/Kconfig"
osource "/opt/zephyr-ws/zephyr/soc/ambiq/Kconfig"
osource "/opt/zephyr-ws/zephyr/soc/altr/zephyr_nios2f/Kconfig"
osource "/opt/zephyr-ws/zephyr/soc/altr/qemu_nios2/Kconfig"
osource "/opt/zephyr-ws/zephyr/soc/adi/max32/Kconfig"
```

## build-psa/Kconfig/Kconfig.modules
```kconfig
menu "cmsis (/opt/zephyr-ws/modules/hal/cmsis)"
osource "$(ZEPHYR_CMSIS_KCONFIG)"
config ZEPHYR_CMSIS_MODULE
	bool
	default y
endmenu
menu "mbedtls (/opt/zephyr-ws/modules/crypto/mbedtls)"
osource "$(ZEPHYR_MBEDTLS_KCONFIG)"
config ZEPHYR_MBEDTLS_MODULE
	bool
	default y
endmenu
config ZEPHYR_MCUBOOT_MODULE
   bool
   default y
menu "picolibc (/opt/zephyr-ws/modules/lib/picolibc)"
osource "/opt/zephyr-ws/modules/lib/picolibc/zephyr/Kconfig"
config ZEPHYR_PICOLIBC_MODULE
	bool
	default y
endmenu
menu "segger (/opt/zephyr-ws/modules/debug/segger)"
osource "$(ZEPHYR_SEGGER_KCONFIG)"
config ZEPHYR_SEGGER_MODULE
	bool
	default y
endmenu
config ZEPHYR_TINYCRYPT_MODULE
   bool
   default y
menu "trusted-firmware-m (/opt/zephyr-ws/modules/tee/tf-m/trusted-firmware-m)"
osource "$(ZEPHYR_TRUSTED_FIRMWARE_M_KCONFIG)"
config ZEPHYR_TRUSTED_FIRMWARE_M_MODULE
	bool
	default y
endmenu
menu "zcbor (/opt/zephyr-ws/modules/lib/zcbor)"
osource "$(ZEPHYR_ZCBOR_KCONFIG)"
config ZEPHYR_ZCBOR_MODULE
	bool
	default y
endmenu
```

## build-psa/Kconfig/arch/Kconfig
```kconfig
# Load arch Kconfig descriptions.
osource "/opt/zephyr-ws/zephyr/arch/x86/Kconfig"
osource "/opt/zephyr-ws/zephyr/arch/xtensa/Kconfig"
osource "/opt/zephyr-ws/zephyr/arch/sparc/Kconfig"
osource "/opt/zephyr-ws/zephyr/arch/riscv/Kconfig"
osource "/opt/zephyr-ws/zephyr/arch/posix/Kconfig"
osource "/opt/zephyr-ws/zephyr/arch/nios2/Kconfig"
osource "/opt/zephyr-ws/zephyr/arch/mips/Kconfig"
osource "/opt/zephyr-ws/zephyr/arch/arm64/Kconfig"
osource "/opt/zephyr-ws/zephyr/arch/arm/Kconfig"
osource "/opt/zephyr-ws/zephyr/arch/arc/Kconfig"
```

## build-upg-v2/Kconfig/Kconfig.sysbuild.modules
```kconfig
config ZEPHYR_CMSIS_MODULE
   bool
   default y
config ZEPHYR_MBEDTLS_MODULE
   bool
   default y
config ZEPHYR_MCUBOOT_MODULE
   bool
   default y
config ZEPHYR_PICOLIBC_MODULE
   bool
   default y
config ZEPHYR_SEGGER_MODULE
   bool
   default y
config ZEPHYR_TINYCRYPT_MODULE
   bool
   default y
config ZEPHYR_TRUSTED_FIRMWARE_M_MODULE
   bool
   default y
config ZEPHYR_ZCBOR_MODULE
   bool
   default y
```
